## conf/layer.conf
```bitbake
# We have a conf and classes directory, append to BBPATH
BBPATH .= ":${LAYERDIR}"

# We have a recipes directory containing .bb and .bbappend files, add to BBFILES
BBFILES += "${LAYERDIR}/recipes*/*/*.bb \
            ${LAYERDIR}/recipes*/*/*.bbappend"

BBFILE_COLLECTIONS += "camera"
BBFILE_PATTERN_camera := "^${LAYERDIR}/"
BBFILE_PRIORITY_camera = "30"

LAYERSERIES_COMPAT_camera = "kirkstone"
LAYERDEPENDS_camera = "raspberrypi"
```
